#include <string.h>
#include <stdio.h>
#include <stdlib.h>
#include "driver/gpio.h"
#include "driver/i2c.h"
#include "esp_err.h"
#include "esp_log.h"
#include "freertos/FreeRTOS.h"
#include "freertos/task.h"
#include "freertos/event_groups.h"
#include "esp_wifi.h"
#include "esp_event.h"
#include "esp_system.h"
#include "nvs_flash.h"

#include "lwip/err.h"
#include "lwip/sockets.h"
#include "lwip/sys.h"
#include "lwip/netdb.h"
#include "lwip/dns.h"


#include "sdkconfig.h" // generated by "make menuconfig"

#include "mbedtls/esp_config.h"

#include "iotex_i2c.h"
#include "i2c_esp32.h"

static const char *TAG = "MAIN";


/************** EXAMPLE ************************/

#include <ex_sss.h>
#include <ex_sss_boot.h>
#include <fsl_sss_se05x_apis.h>
#include <nxEnsure.h>
#include <nxLog_App.h>

#define EC_KEY_BIT_LEN 256

const uint8_t keyPairData[] = { 0x30, 0x81, 0x87, 0x02, 0x01, 0x00, 0x30, 0x13,
    0x06, 0x07, 0x2A, 0x86, 0x48, 0xCE, 0x3D, 0x02,
    0x01, 0x06, 0x08, 0x2A, 0x86, 0x48, 0xCE, 0x3D,
    0x03, 0x01, 0x07, 0x04, 0x6D, 0x30, 0x6B, 0x02,
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    0x68, 0x7C };

const uint8_t extPubKeyData[] = {
    0x30, 0x59, 0x30, 0x13, 0x06, 0x07, 0x2A, 0x86,
    0x48, 0xCE, 0x3D, 0x02, 0x01, 0x06, 0x08, 0x2A,
    0x86, 0x48, 0xCE, 0x3D, 0x03, 0x01, 0x07, 0x03,
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    0x8E, 0x68, 0x7C
};


static ex_sss_boot_ctx_t gex_sss_ecc_boot_ctx;


#define EX_SSS_BOOT_PCONTEXT (&gex_sss_ecc_boot_ctx)
#define EX_SSS_BOOT_DO_ERASE 1
#define EX_SSS_BOOT_EXPOSE_ARGC_ARGV 0

/* ************************************************************************** */
/* Include "main()" with the platform specific startup code for Plug & Trust  */
/* MW examples which will call ex_sss_entry()                                 */
/* ************************************************************************** */
#include <ex_sss_main_inc.h>

sss_status_t ex_sss_entry(ex_sss_boot_ctx_t *pCtx)
{
    sss_status_t status = kStatus_SSS_Success;
    uint8_t digest[32]  = "Hello World";
    size_t digestLen;
    uint8_t signature[256] = {0};
    size_t signatureLen;
    sss_object_t keyPair        = {0};
    sss_object_t key_pub        = {0};
    sss_asymmetric_t ctx_asymm  = {0};
    sss_asymmetric_t ctx_verify = {0};

    LOG_I("Running Elliptic Curve Cryptography Example ex_sss_ecc.c");

    digestLen = sizeof(digest);

    /* doc:start ex_sss_asymmetric-allocate-key */
    /* Pre-requisite for Signing Part*/
    status = sss_key_object_init(&keyPair, &pCtx->ks);
    ENSURE_OR_GO_CLEANUP(status == kStatus_SSS_Success);

    status = sss_key_object_allocate_handle(&keyPair,
        MAKE_TEST_ID(__LINE__),
        kSSS_KeyPart_Pair,
        kSSS_CipherType_EC_NIST_P,
        sizeof(keyPairData),
        kKeyObject_Mode_Persistent);
    ENSURE_OR_GO_CLEANUP(status == kStatus_SSS_Success);

    status = sss_key_store_set_key(&pCtx->ks, &keyPair, keyPairData, sizeof(keyPairData), EC_KEY_BIT_LEN, NULL, 0);
    ENSURE_OR_GO_CLEANUP(status == kStatus_SSS_Success);

    /* doc:end ex_sss_asymmetric-allocate-key */

    /* doc:start ex_sss_asymmetric-asym-sign */
    status = sss_asymmetric_context_init(&ctx_asymm, &pCtx->session, &keyPair, kAlgorithm_SSS_SHA256, kMode_SSS_Sign);
    ENSURE_OR_GO_CLEANUP(status == kStatus_SSS_Success);

    signatureLen = sizeof(signature);
    /* Do Signing */
    LOG_I("Do Signing");
    LOG_MAU8_I("digest", digest, digestLen);
    status = sss_asymmetric_sign_digest(&ctx_asymm, digest, digestLen, signature, &signatureLen);
    ENSURE_OR_GO_CLEANUP(status == kStatus_SSS_Success);
    LOG_MAU8_I("signature", signature, signatureLen);
    LOG_I("Signing Successful !!!");
    sss_asymmetric_context_free(&ctx_asymm);
    /* doc:end ex_sss_asymmetric-asym-sign */

    /* Pre requiste for Verifying Part*/
    status = sss_key_object_init(&key_pub, &pCtx->ks);
    ENSURE_OR_GO_CLEANUP(status == kStatus_SSS_Success);

    status = sss_key_object_allocate_handle(&key_pub,
        MAKE_TEST_ID(__LINE__),
        kSSS_KeyPart_Public,
        kSSS_CipherType_EC_NIST_P,
        sizeof(extPubKeyData),
        kKeyObject_Mode_Persistent);
    ENSURE_OR_GO_CLEANUP(status == kStatus_SSS_Success);

    status = sss_key_store_set_key(&pCtx->ks, &key_pub, extPubKeyData, sizeof(extPubKeyData), EC_KEY_BIT_LEN, NULL, 0);
    ENSURE_OR_GO_CLEANUP(status == kStatus_SSS_Success);

    /* doc:start ex_sss_asymmetric-asym-verify */
    status =
        sss_asymmetric_context_init(&ctx_verify, &pCtx->session, &key_pub, kAlgorithm_SSS_SHA256, kMode_SSS_Verify);
    ENSURE_OR_GO_CLEANUP(status == kStatus_SSS_Success);

    LOG_I("Do Verify");
    LOG_MAU8_I("digest", digest, digestLen);
    LOG_MAU8_I("signature", signature, signatureLen);
    status = sss_asymmetric_verify_digest(&ctx_verify, digest, digestLen, signature, signatureLen);
    ENSURE_OR_GO_CLEANUP(status == kStatus_SSS_Success);
    LOG_I("Verification Successful !!!");
    /* doc:end ex_sss_asymmetric-asym-verify */

cleanup:
    if (kStatus_SSS_Success == status) {
        LOG_I("ex_sss_ecc Example Success !!!...");
    }
    else {
        LOG_E("ex_sss_ecc Example Failed !!!...");
    }
    if (ctx_asymm.session != NULL) {
        sss_asymmetric_context_free(&ctx_asymm);
    }
    if (ctx_verify.session != NULL) {
        sss_asymmetric_context_free(&ctx_verify);
    }
    sss_key_object_free(&keyPair);
    sss_key_object_free(&key_pub);
    return status;
}


/***********************************************/



void app_main(void)
{
	//i2c_master_init();
    ESP_ERROR_CHECK( nvs_flash_init() );   

    //****************************************************************//

    gpio_reset_pin(4);
    gpio_set_direction(4, GPIO_MODE_OUTPUT);
    gpio_set_level(4, 1);

    // I2C init
    iotex_i2c_init();
    i2c_esp32_set_status(I2C_ESP32_STATUS_INIT);

    // ********* PCA9420 POWER MANAGER TEST AND SET *********

    ESP_LOGI("TEST", "Power Manager NXP PCA9420 Test and configure");
    
    // I2C Communication with NXP Power Manager
    uint8_t nxp_devinfo_reg_addr = 0x00;
    uint8_t nxp_modecfg00_reg_addr = 0x22;
    uint8_t nxp_modecfg01_reg_addr = 0x23;
    uint8_t nxp_topctl0_reg_addr = 0x09;
    
    //uint8_t nxp_write_buf[2];
    uint8_t nxp_read_buf, nxp_write_buf;

    // Read id register
    ESP_LOGI(TAG, "Reading id register from NXP Power Manager");
    if (iotex_PC9420_read_reg(&nxp_devinfo_reg_addr, &nxp_read_buf) == ESP_OK) {
        ESP_LOGI(TAG, "PCA9420 ID register value: 0x%x", nxp_read_buf);
    } else {
        ESP_LOGE(TAG, "PCA9420 ID register read FAILED");
    }

    // Set V_PER to 3.3 Volt (SW2: modecfg_0_1 register)
    ESP_LOGI(TAG, "Setting V_PER to 3.3 Volts");

    if (iotex_PC9420_read_reg(&nxp_modecfg01_reg_addr, &nxp_read_buf) == ESP_OK) {
        ESP_LOGI(TAG, "Previous PCA9420 modecfg_0_1 register value: 0x%x", nxp_read_buf);
        nxp_write_buf = (nxp_read_buf | 0b00111111);
        if (iotex_PC9420_write_reg(&nxp_modecfg01_reg_addr, &nxp_write_buf) != ESP_OK) {
            ESP_LOGE(TAG, "FAILED writing PCA9420 modecfg_0_1 register");
        }

    } else {
        ESP_LOGE(TAG, "PCA9420 modecfg_0_1 register read FAILED");
    }

    // Set V_GPS to 1.8 Volt (SW1: modecfg_0_0 register)
    ESP_LOGI(TAG, "Setting V_GPS to 1.8 Volts");

    if (iotex_PC9420_read_reg(&nxp_modecfg00_reg_addr, &nxp_read_buf) == ESP_OK) {
        ESP_LOGI(TAG, "Previous PCA9420 modecfg_0_0 register value: 0x%x", nxp_read_buf);
        nxp_write_buf = (nxp_read_buf | 0b00111111);
        if (iotex_PC9420_write_reg(&nxp_modecfg00_reg_addr, &nxp_write_buf) != ESP_OK) {
            ESP_LOGE(TAG, "FAILED writing PCA9420 modecfg_0_0 register");
        }

    } else {
        ESP_LOGE(TAG, "PCA9420 modecfg_0_0 register read FAILED");
    }

    // Set input current limit to maximum
    ESP_LOGI(TAG, "Setting input current limit to maximum");

    if (iotex_PC9420_read_reg(&nxp_topctl0_reg_addr, &nxp_read_buf) == ESP_OK) {
        ESP_LOGI(TAG, "Previous PCA9420 top_ctl0 register value: 0x%x", nxp_read_buf);
        nxp_write_buf = (((nxp_read_buf | 0b10000000) & 0b10011111)); //VIN_ILIM_SEL = 101 (default:010)
        ESP_LOGI(TAG, "Writing value: 0x%x", nxp_write_buf);
        if (iotex_PC9420_write_reg(&nxp_topctl0_reg_addr, &nxp_write_buf) != ESP_OK) {
           ESP_LOGE(TAG, "FAILED writing PCA9420 top_ctl0 register");
        }

    } else {
        ESP_LOGE(TAG, "PCA9420 top_ctl0 register read FAILED");
    }
    // ******************************************************




    main( 1 ,NULL);
}